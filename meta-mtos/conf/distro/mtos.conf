## meta-mtos/conf/distro/mtos.conf
```bitbake
DISTRO = "mtos"
DISTRO_NAME = "MTOS (MTOS Powered By Yocto Project)"
DISTRO_VERSION = "5.0.4"
DISTRO_CODENAME = "scarthgap"
SDK_VENDOR = "-mtossdk"
SDK_VERSION = "${@d.getVar('DISTRO_VERSION').replace('snapshot-${METADATA_REVISION}', 'snapshot')}"
SDK_VERSION[vardepvalue] = "${SDK_VERSION}"

MAINTAINER = "MTOS Maintainers <mtos@mthreads.com>"

TARGET_VENDOR = "-mtos"

LOCALCONF_VERSION = "2"

# Override these in poky based distros
MTOS_DEFAULT_DISTRO_FEATURES = "opengl ptest multiarch wayland vulkan systemd polkit pam"
MTOS_DEFAULT_EXTRA_RDEPENDS = "packagegroup-core-boot"
MTOS_DEFAULT_EXTRA_RRECOMMENDS = "kernel-module-af-packet"

DISTRO_FEATURES ?= "${DISTRO_FEATURES_DEFAULT} ${MTOS_DEFAULT_DISTRO_FEATURES}" 
PREFERRED_VERSION_linux-yocto ?= "6.6%"
PREFERRED_VERSION_linux-yocto-rt ?= "6.6%"

SDK_NAME = "${DISTRO}-${TCLIBC}-${SDKMACHINE}-${IMAGE_BASENAME}-${TUNE_PKGARCH}-${MACHINE}"
SDKPATHINSTALL = "/opt/${DISTRO}/${SDK_VERSION}"

DISTRO_EXTRA_RDEPENDS += "${MTOS_DEFAULT_EXTRA_RDEPENDS}"
DISTRO_EXTRA_RRECOMMENDS += "${MTOS_DEFAULT_EXTRA_RRECOMMENDS}"

TCLIBCAPPEND = ""

PACKAGE_CLASSES ?= "package_deb"

SANITY_TESTED_DISTROS ?= " \
            ubuntu-20.04 \n \
            ubuntu-22.04 \n \
            "
# add poky sanity bbclass
# INHERIT += "poky-sanity"

# QA check settings - a little stricter than the OE-Core defaults
# (none currently necessary as we now match OE-Core)
#WARN_TO_ERROR_QA = "X"
#WARN_QA_remove = "${WARN_TO_ERROR_QA}"
#ERROR_QA_append = " ${WARN_TO_ERROR_QA}"

require conf/distro/include/no-static-libs.inc
require conf/distro/include/yocto-uninative.inc
require conf/distro/include/security_flags.inc
INHERIT += "uninative"

BB_SIGNATURE_HANDLER ?= "OEEquivHash"
BB_HASHSERVE ??= "auto"

MTOS_INIT_MANAGER = "systemd"
INIT_MANAGER ?= "${MTOS_INIT_MANAGER}"

# We need debug symbols so that SPDX license manifests for the kernel work
KERNEL_EXTRA_FEATURES:append = " features/debug/debug-kernel.scc"

# Enable creation of SPDX manifests by default
INHERIT += "create-spdx"
```

## meta-mtos/conf/layer.conf
```bitbake
# We have a conf and classes directory, add to BBPATH
BBPATH .= ":${LAYERDIR}"

# We have recipes-* directories, add to BBFILES
BBFILES += "${LAYERDIR}/recipes-*/*/*.bb \
            ${LAYERDIR}/recipes-*/*/*.bbappend"

BBFILE_COLLECTIONS += "meta-mtos"
BBFILE_PATTERN_meta-mtos = "^${LAYERDIR}/"
BBFILE_PRIORITY_meta-mtos = "6"

LAYERDEPENDS_meta-mtos = "core"
LAYERSERIES_COMPAT_meta-mtos = "scarthgap"
```
